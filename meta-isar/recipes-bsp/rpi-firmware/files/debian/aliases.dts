/* --------------------------------------------------------------------------
 * This Isar layer is part of MTDA
 * Copyright (c) Siemens AG, 2021-2022
 * --------------------------------------------------------------------------
 * SPDX-License-Identifier: MIT
 * --------------------------------------------------------------------------
 */

/dts-v1/;
/plugin/;
&{/aliases} {
	/* Ensure stable /dev/mmcblk0 assignment */
	mmc0 = "/emmc2bus/mmc@7e340000";
	mmc1 = "/soc/mmc@7e300000";
};
