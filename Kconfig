## Kconfig
```kconfig
# ---------------------------------------------------------------------------
# Top-level Kconfig file for MTDA
# ---------------------------------------------------------------------------
#
# This software is a part of MTDA.
# Copyright (C) 2024 Siemens Digital Industries Software
#
# ---------------------------------------------------------------------------
# SPDX-License-Identifier: MIT
# ---------------------------------------------------------------------------

menu "General Settings"
config EXPERIMENTAL
    bool "Experimental features"
    default n
    help
      Enable experimental features.
endmenu

menu "Main Settings"
config MAIN_DEBUG
    int "Debug log level"
    default 2
    help
      Level of debug messages to print out while running (set to 0 to turn all
      debug messages off).

config MAIN_FUSE
    bool "FUSE support"
    depends on EXPERIMENTAL
    default n
    help
      Enable support for mounting partitions from the shared device using FUSE
      instead of losetup and mount. This feature is experimental and
      requires partitionfs, fuseext2 and fusefat.

config MAIN_HOSTNAME
    string "Agent network name"
    help
      Name of this agent on the network (defaults to hostname).
endmenu

menu "Environment Settings"
config ENVIRONMENT_VARIANT
    string "Custom device scripts variant"
    help
      Ease sharing of device scripts that are used to boot from USB,
      reset the TPM, enable Secure Boot, etc. by having MTDA load
      them from mtda.script.<ENVIRONMENT_VARIANT>.

endmenu

menu "Pastebin Settings"

config PASTEBIN_API
    string "Pastebin API key"
    help
      Define the API key to be passed to the pastebin service

config PASTEBIN_ENDPOINT
    string "Pastebin endpoint URL"
    help
      Specify an alternate pastebin service (defaults to
      http://pastebin.com/api/api_post.php)

endmenu

menu "UI settings"

config UI_PREFIX
    string "Prefix key to control UI"
    help
      Change the key prefix to control the interactive MTDA console. The default
      prefix is 'ctrl-a' (which is also used by the 'screen' tool, this
      setting may be used to use e.g. 'ctrl-b' instead).
endmenu

menu "Console Settings"

config CONSOLE_VARIANT
    string "Console driver variant"
    help
      Select a console variant. MTDA provides the following drivers: 'serial'
      and 'telnet'.
endmenu

menu "Keyboard Settings"
config KEYBOARD_VARIANT
    string "Keyboard driver"
    help
      Select a keyboard driver between 'hid' and 'qemu'.
endmenu

menu "Monitor console settings"
config MONITOR_VARIANT
    string "Console variant"
    help
      'variant' key should be set, other settings in this section are
       variant-specific.
endmenu

menu "Power Control Settings"
config POWER_VARIANT
    string "Power variant"
    default "qemu"
    help
      Select a power variant from 'aviosys_8800', 'gpio', 'pduclient',
      'qemu' and 'usbrelay'.
endmenu

menu "Remote Settings"
config REMOTE_CONTROL
    int "Control port number"
    default 5556
    help
      Remote port listening for control commands (defaults to '5556').

config REMOTE_CONSOLE
    int "Console port number"
    default 5557
    help
      Remote port to connect to in order to get console messages (defaults to
      '5557').

config REMOTE_HOST
    string "Hostname"
    default "localhost"
    help
      Remote host name or ip to connect to as a client to interact with the
      MTDA agent (defaults to 'localhost').
endmenu

menu "Console Settings"
config CONSOLE_VARIANT
    string "Console variant"
    default "qemu"
    help
      Select a shared storage variant from 'docker', 'qemu', 'samsung'
      and 'usbf'.
endmenu

menu "Video Settings"
config VIDEO_VARIANT
    string "Video variant"
    help
      Select a 'video' variant: 'mjpg_streamer' is the only supported
      driver at this time.
endmenu

menu "Storage Settings"
config STORAGE_VARIANT
    string "Storage type"
    default "qemu"
    help
      Select a shared storage variant from 'docker', 'qemu', 'samsung'
      and 'usbf'.

config STORAGE_FILE
    string "Storage file"
    default "/var/lib/mtda/usb-shared-storage.img"
endmenu

menu "Webserver settings"
config WWW_PORT
    int "HTTP port"
    default 5000
    help
      Port to run the HTTP service on (defaults to 5000).

config WWW_HOST
    string "Host Address"
    default "127.0.0.1"
    help
      Host address to listen on. This defaults to '127.0.0.1' to only
      accept connections from the machine running the MTDA service.

      Change to '0.0.0.0' to accept connections from anywhere.
endmenu
```

## meta-isar-extra/conf/layer.conf
```bitbake
# ---------------------------------------------------------------------------
# This Isar layer is part of MTDA
# Copyright (C) 2025 Siemens AG
# ---------------------------------------------------------------------------
# SPDX-License-Identifier: MIT
# ---------------------------------------------------------------------------

MTDA_LAYER := "${LAYERDIR}"

BBPATH .= ":${LAYERDIR}"
BBFILES += "                           \
    ${LAYERDIR}/recipes-*/*/*.bb       \
    ${LAYERDIR}/recipes-*/*/*.bbappend \
"

BBFILE_COLLECTIONS += "mtda-extra"
BBFILE_PATTERN_mtda-extra = "^${LAYERDIR}/"
BBFILE_PRIORITY_mtda-extra = "10"

LAYERVERSION_mtda-extra = "1"
LAYERSERIES_COMPAT_mtda-extra = "v0.6"
LAYERDIR_mtda-extra = "${LAYERDIR}"
LAYERDIR_mtda-extra[vardepvalue] = "mtda-extra"
```

## meta-isar-extra/conf/machine/abrootfs-common.inc
```bitbake
# ---------------------------------------------------------------------------
# This Isar layer is part of MTDA
# Copyright (C) 2025 Siemens AG
# ---------------------------------------------------------------------------
# SPDX-License-Identifier: MIT
# ---------------------------------------------------------------------------

SWUPDATE_BOOTLOADER ?= "efibootguard"
SWU_EFI_BOOT_DEVICE ?= "/dev/disk/by-uuid/2321-DCBA"
INITRAMFS_INSTALL += " \
    initramfs-squashfs-hook \
    initramfs-abrootfs-hook \
"
IMAGE_TYPEDEP:wic += "squashfs"
IMAGE_FSTYPES += "swu"

# list of compatible hardware revisions
SWU_HW_COMPAT ?= "mtda-${MACHINE}"
# the hardware revision of the current machine
MACHINE_HW_VERSION ?= "mtda-${MACHINE}"
IMAGE_INSTALL += "swupdate-config-${MACHINE}"

# the squashfs is already compressed. Do not compress externally
SWU_COMPRESSION_TYPE = ""
# compress the initrd with zstd to speedup decompression
INITRAMFS_PREINSTALL += "zstd"
```

## meta-isar-extra/conf/machine/nanopi-neo-ebg.conf
```bitbake
# ---------------------------------------------------------------------------
# This Isar layer is part of MTDA
# Copyright (C) 2025 Siemens AG
# ---------------------------------------------------------------------------
# SPDX-License-Identifier: MIT
# ---------------------------------------------------------------------------

require conf/machine/nanopi-neo-efi.conf
require conf/machine/abrootfs-common.inc

WDOG_TIMEOUT = "0"
WKS_FILE = "nanopi-neo-ebg.wks.in"
```

## meta-isar-extra/conf/machine/qemuamd64-ebg.conf
```bitbake
# ---------------------------------------------------------------------------
# This Isar layer is part of MTDA
# Copyright (C) 2025 Siemens AG
# ---------------------------------------------------------------------------
# SPDX-License-Identifier: MIT
# ---------------------------------------------------------------------------

require conf/machine/abrootfs-common.inc

DISTRO_ARCH ?= "amd64"
KERNEL_NAME ?= "amd64"

IMAGE_FSTYPES += "wic"
WKS_FILE = "qemuamd64-ebg.wks.in"
WDOG_TIMEOUT = "0"
```

## meta-isar-extra/conf/machine/rpi4b-ebg.conf
```bitbake
# ---------------------------------------------------------------------------
# This Isar layer is part of MTDA
# Copyright (C) 2025 Siemens AG
# ---------------------------------------------------------------------------
# SPDX-License-Identifier: MIT
# ---------------------------------------------------------------------------

require conf/machine/rpi-arm64-v8-efi.inc
require conf/machine/abrootfs-common.inc

WDOG_TIMEOUT = "0"
WKS_FILE = "rpi4b-ebg.wks.in"
```

## meta-isar/conf/distro/mtda-bookworm.conf
```bitbake
# ---------------------------------------------------------------------------
# This Isar layer is part of MTDA
# Copyright (C) 2025 Siemens AG
# ---------------------------------------------------------------------------
# SPDX-License-Identifier: MIT
# ---------------------------------------------------------------------------

require conf/distro/debian-bookworm.conf

DISTRO_APT_SOURCES:append:mtda-bookworm = " conf/distro/debian-bookworm-backports.list"
DISTRO_APT_PREFERENCES:append:mtda-bookworm = " conf/distro/preferences.mtda-bookworm-backports.conf"
HOST_DISTRO_APT_SOURCES:append:mtda-bookworm = " conf/distro/debian-bookworm-backports.list"
HOST_DISTRO_APT_PREFERENCES:append:mtda-bookworm = " conf/distro/preferences.mtda-bookworm-backports.conf"
```

## meta-isar/conf/distro/mtda-bullseye.conf
```bitbake
# ---------------------------------------------------------------------------
# This Isar layer is part of MTDA
# Copyright (C) 2023 Siemens Digital Industries Software
# ---------------------------------------------------------------------------
# SPDX-License-Identifier: MIT
# ---------------------------------------------------------------------------

require conf/distro/debian-bullseye.conf

DISTRO_APT_PREFERENCES:append = " conf/apt/debian-bullseye-backports.conf"
DISTRO_APT_SOURCES:append = " conf/apt/debian-bullseye-backports.list"
```

## meta-isar/conf/distro/mtda-trixie.conf
```bitbake
# ---------------------------------------------------------------------------
# This Isar layer is part of MTDA
# Copyright (C) 2026 Siemens AG
# ---------------------------------------------------------------------------
# SPDX-License-Identifier: MIT
# ---------------------------------------------------------------------------

require conf/distro/debian-trixie.conf
```

## meta-isar/conf/layer.conf
```bitbake
# ---------------------------------------------------------------------------
# This Isar layer is part of MTDA
# Copyright (C) 2023 Siemens Digital Industrial Software
# ---------------------------------------------------------------------------
# SPDX-License-Identifier: MIT
# ---------------------------------------------------------------------------

MTDA_LAYER := "${LAYERDIR}"

BBPATH .= ":${LAYERDIR}"
BBFILES += "                           \
    ${LAYERDIR}/recipes-*/*/*.bb       \
    ${LAYERDIR}/recipes-*/*/*.bbappend \
"

BBFILE_COLLECTIONS += "mtda"
BBFILE_PATTERN_mtda = "^${LAYERDIR}/"
BBFILE_PRIORITY_mtda = "10"

LAYERVERSION_mtda = "1"
LAYERSERIES_COMPAT_mtda = "v0.6"
LAYERDIR_mtda = "${LAYERDIR}"
LAYERDIR_mtda[vardepvalue] = "mtda"

THIRD_PARTY_APT_KEYS:append = " https://apt.fury.io/mtda/gpg.key;md5sum=bbdc764e1a3028aa70b6735692367f16"
```

## meta-isar/conf/machine/beaglebone-black.conf
```bitbake
# ---------------------------------------------------------------------------
# This Isar layer is part of MTDA
# Copyright (C) 2025 Siemens AG
# ---------------------------------------------------------------------------
# SPDX-License-Identifier: MIT
# ---------------------------------------------------------------------------

DISTRO_ARCH ?= "armhf"

KERNEL_NAME ?= "armmp"

IMAGE_FSTYPES ?= "wic"
WKS_FILE ?= "beaglebone-black.wks.in"

IMAGER_INSTALL += "u-boot-omap"
```

## meta-isar/conf/machine/nanopi-r1.conf
```bitbake
# ---------------------------------------------------------------------------
# This Isar layer is part of MTDA
# Copyright (C) 2025 Siemens AG
# ---------------------------------------------------------------------------
# SPDX-License-Identifier: MIT
# ---------------------------------------------------------------------------

DISTRO_ARCH ?= "armhf"

KERNEL_NAME ?= "armmp"

IMAGE_FSTYPES ?= "wic"
WKS_FILE ?= "nanopi-r1.wks.in"

IMAGER_INSTALL += "u-boot-nanopi-r1"
PREFERRED_PROVIDER_u-boot-nanopi-r1 = "u-boot-nanopi-r1"

IMAGE_INSTALL += " firmware-nanopi-r1"
```

## meta-isar/conf/machine/rpi4b-efi.conf
```bitbake
# ---------------------------------------------------------------------------
# This Isar layer is part of MTDA
# Copyright (c) Siemens AG, 2025
# ---------------------------------------------------------------------------
# SPDX-License-Identifier: MIT
# ---------------------------------------------------------------------------

require conf/machine/rpi4b-efi.inc

IMAGER_INSTALL:wic += "${SYSTEMD_BOOTLOADER_INSTALL}"
```

## meta-isar/conf/machine/rpi4b-efi.inc
```bitbake
# ---------------------------------------------------------------------------
# This Isar layer is part of MTDA
# Copyright (c) Siemens AG, 2025
# ---------------------------------------------------------------------------
# SPDX-License-Identifier: MIT
# ---------------------------------------------------------------------------

DISTRO_ARCH ?= "arm64"

KERNEL_NAME ?= "arm64"

IMAGE_FSTYPES ??= "wic"
WKS_FILE ??= "rpi4b-efi.wks"

IMAGER_BUILD_DEPS = "u-boot-config-rpi4b"
IMAGER_INSTALL:wic += "${IMAGER_BUILD_DEPS}"

IMAGE_EFI_BOOT_FILES = " \
    /usr/lib/u-boot-config-rpi4b/config.txt;config.txt \
    /usr/lib/u-boot/rpi_arm64/u-boot.bin;u-boot.bin \
    /usr/lib/rpi-firmware/fixup4.dat;fixup4.dat \
    /usr/lib/rpi-firmware/start4.elf;start4.elf \
    /usr/lib/rpi-firmware/overlays/*;overlays/ \
    ${IMAGE_ROOTFS}/usr/lib/linux-image-*/broadcom/bcm2711-rpi-4-b.dtb \
"

IMAGE_PREINSTALL:append = " firmware-brcm80211"
```

## meta-isar/conf/machine/rpi4b.conf
```bitbake
# ---------------------------------------------------------------------------
# This Isar layer is part of MTDA
# Copyright (c) Siemens AG, 2022
# ---------------------------------------------------------------------------
# SPDX-License-Identifier: MIT
# ---------------------------------------------------------------------------

DISTRO_ARCH ?= "arm64"

KERNEL_NAME ?= "arm64"

IMAGE_FSTYPES ?= "wic"
WKS_FILE ?= "rpi4b.wks"

IMAGER_BUILD_DEPS = "rpi-firmware linux-image-${KERNEL_NAME}"
IMAGER_INSTALL += "${IMAGER_BUILD_DEPS}"

IMAGE_BOOT_FILES = " \
    /usr/lib/rpi-firmware/bootcode.bin;bootcode.bin \
    /usr/lib/rpi-firmware/cmdline.txt;cmdline.txt \
    /usr/lib/rpi-firmware/config.txt;config.txt \
    /usr/lib/rpi-firmware/fixup4.dat;fixup4.dat \
    /usr/lib/rpi-firmware/fixup4x.dat;fixup4x.dat \
    /usr/lib/rpi-firmware/start4.elf;start4.elf \
    /usr/lib/rpi-firmware/start4x.elf;start4x.elf \
    /usr/lib/rpi-firmware/overlays/*;overlays/ \
    /usr/lib/linux-image-*/broadcom/bcm2711-rpi-4-b.dtb \
    /usr/lib/linux-image-*/overlays/*;overlays/ \
    /vmlinuz;kernel8.img \
    /initrd.img;initrd.img \
    "

IMAGE_PREINSTALL_append = " firmware-brcm80211"
```

## meta-isar/scripts/lib/wic/canned-wks/rpi4b.wks
```
# ---------------------------------------------------------------------------
# This OpenEmbedded Kickstart file is part of MTDA
# Copyright (c) Siemens AG, 2022
# ---------------------------------------------------------------------------
# SPDX-License-Identifier: MIT
# ---------------------------------------------------------------------------

part /boot --source bootimg-partition --ondisk mmcblk0 --fstype vfat --label boot --align 1 --size 128 --overhead-factor 1 --extra-space 0

part / --source rootfs --ondisk mmcblk0 --fstype ext4 --mkfs-extraopts "-T default" --label platform --align 1024 --active --exclude-path=boot/

# silence wic
bootloader
```
