## meta-isar/scripts/lib/wic/canned-wks/sdimage-efi.wks
```
# ---------------------------------------------------------------------------
# This OpenEmbedded Kickstart file is part of MTDA
# Copyright (C) 2023 Siemens Digital Industries Software
# ---------------------------------------------------------------------------
# SPDX-License-Identifier: MIT
# ---------------------------------------------------------------------------

part /boot --source bootimg-efi-isar --sourceparams "loader=grub-efi" --ondisk sda --label efi --part-type EF00 --align 1024 --use-uuid
part / --source rootfs --ondisk sda --fstype ext4 --mkfs-extraopts "-T default" --label platform --align 1024 --use-uuid --exclude-path boot/

bootloader --ptable gpt --timeout 3 --append "rootwait console=ttyS0,115200 console=tty0"
```

## meta-yocto/conf/layer.conf
```bitbake
# ---------------------------------------------------------------------------
# This yocto layer is part of MTDA
# Copyright (C) 2023 Siemens Digital Industrial Software
# ---------------------------------------------------------------------------
# SPDX-License-Identifier: MIT
# ---------------------------------------------------------------------------

# We have a conf and classes directory, add to BBPATH
BBPATH .= ":${LAYERDIR}"

# We have recipes-* directories, add to BBFILES
BBFILES += "${LAYERDIR}/recipes-*/*/*.bb \
            ${LAYERDIR}/recipes-*/*/*.bbappend"

BBFILE_COLLECTIONS += "meta-mtda-oe"
BBFILE_PATTERN_meta-mtda-oe = "^${LAYERDIR}/"
BBFILE_PRIORITY_meta-mtda-oe = "10"

LAYERDEPENDS_meta-mtda-oe = "core"
LAYERSERIES_COMPAT_meta-mtda-oe = "kirkstone mickledore"
LAYERDIR_mtda = "${LAYERDIR}"

DISTRO_FEATURES:append = " systemd "
VIRTUAL-RUNTIME_init_manager = "systemd"
```
